## main/Kconfig.projbuild
```kconfig
menu "Tro ly Xiaozhi"

config OTA_URL
    string "URL OTA mac dinh"
    default "https://api.tenclass.net/xiaozhi/ota/"
    help
        Ung dung se truy cap URL nay de kiem tra firmware moi va dia chi may chu.

choice
    prompt "Ghi (flash) goi tai nguyen"
    default FLASH_DEFAULT_ASSETS
    help
        Chon goi tai nguyen se duoc ghi (flash).

    config FLASH_NONE_ASSETS
        bool "Khong ghi (flash) goi tai nguyen"

    config FLASH_DEFAULT_ASSETS
        bool "Ghi (flash) goi tai nguyen mac dinh"

    config FLASH_CUSTOM_ASSETS
        bool "Ghi (flash) goi tai nguyen tuy chinh"
endchoice

config CUSTOM_ASSETS_FILE
    depends on FLASH_CUSTOM_ASSETS
    string "Tep goi tai nguyen tuy chinh"
    default "assets.bin"
    help
        Tep goi tai nguyen tuy chinh de ghi (flash).
        Co the la tep cuc bo tuong doi voi thu muc du an hoac mot URL tu xa.

choice
    prompt "Ngon ngu mac dinh"
    default LANGUAGE_ZH_CN
    help
        Chon ngon ngu hien thi cua thiet bi

    config LANGUAGE_ZH_CN
        bool "Tieng Trung (Gian the)"

    config LANGUAGE_ZH_TW
        bool "Tieng Trung (Phon the)"

    config LANGUAGE_EN_US
        bool "Tieng Anh"

    config LANGUAGE_JA_JP
        bool "Tieng Nhat"

    config LANGUAGE_KO_KR
        bool "Tieng Han"

    config LANGUAGE_VI_VN
        bool "Tieng Viet"

    config LANGUAGE_TH_TH
        bool "Tieng Thai"

    config LANGUAGE_DE_DE
        bool "Tieng Duc"

    config LANGUAGE_FR_FR
        bool "Tieng Phap"

    config LANGUAGE_ES_ES
        bool "Tieng Tay Ban Nha"

    config LANGUAGE_IT_IT
        bool "Tieng Y"

    config LANGUAGE_RU_RU
        bool "Tieng Nga"

    config LANGUAGE_AR_SA
        bool "Tieng A Rap"

    config LANGUAGE_HI_IN
        bool "Tieng Hindi"

    config LANGUAGE_PT_PT
        bool "Tieng Bo Dao Nha"

    config LANGUAGE_PL_PL
        bool "Tieng Ba Lan"

    config LANGUAGE_CS_CZ
        bool "Tieng Sec"

    config LANGUAGE_FI_FI
        bool "Tieng Phan Lan"

    config LANGUAGE_TR_TR
        bool "Tieng Tho Nhi Ky"

    config LANGUAGE_ID_ID
        bool "Tieng Indonesia"

    config LANGUAGE_UK_UA
        bool "Tieng Ukraina"

    config LANGUAGE_RO_RO
        bool "Tieng Romania"

    config LANGUAGE_BG_BG
        bool "Tieng Bulgaria"

    config LANGUAGE_CA_ES
        bool "Tieng Catalan"

    config LANGUAGE_DA_DK
        bool "Tieng Dan Mach"

    config LANGUAGE_EL_GR
        bool "Tieng Hy Lap"

    config LANGUAGE_FA_IR
        bool "Tieng Ba Tu"

    config LANGUAGE_FIL_PH
        bool "Tieng Philippines"

    config LANGUAGE_HE_IL
        bool "Tieng Do Thai"

    config LANGUAGE_HR_HR
        bool "Tieng Croatia"

    config LANGUAGE_HU_HU
        bool "Tieng Hungary"

    config LANGUAGE_MS_MY
        bool "Tieng Malaysia"

    config LANGUAGE_NB_NO
        bool "Tieng Na Uy"

    config LANGUAGE_NL_NL
        bool "Tieng Ha Lan"

    config LANGUAGE_SK_SK
        bool "Tieng Slovakia"

    config LANGUAGE_SL_SI
        bool "Tieng Slovenia"

    config LANGUAGE_SV_SE
        bool "Tieng Thuy Dien"

    config LANGUAGE_SR_RS
        bool "Tieng Serbia"
endchoice

choice BOARD_TYPE
    prompt "Loai bo mach"
    default BOARD_TYPE_BREAD_COMPACT_WIFI
    help
        Loai bo phat trien

    config BOARD_TYPE_BREAD_COMPACT_WIFI
        bool "Bread Compact WiFi (dang breadboard)"
        depends on IDF_TARGET_ESP32S3

    config BOARD_TYPE_BREAD_COMPACT_WIFI_LCD
        bool "Bread Compact WiFi + LCD (dang breadboard)"
        depends on IDF_TARGET_ESP32S3

    config BOARD_TYPE_BREAD_COMPACT_WIFI_CAM
        bool "Bread Compact WiFi + LCD + Camera (dang breadboard)"
        depends on IDF_TARGET_ESP32S3

    config BOARD_TYPE_BREAD_COMPACT_ML307
        bool "Bread Compact ML307/EC801E (dang breadboard 4G)"
        depends on IDF_TARGET_ESP32S3

    config BOARD_TYPE_BREAD_COMPACT_ESP32
        bool "Bread Compact ESP32 DevKit (dang breadboard)"
        depends on IDF_TARGET_ESP32

    config BOARD_TYPE_BREAD_COMPACT_ESP32_LCD
        bool "Bread Compact ESP32 DevKit + LCD (dang breadboard)"
        depends on IDF_TARGET_ESP32

    config BOARD_TYPE_XMINI_C3_V3
        bool "Xmini C3 V3"
        depends on IDF_TARGET_ESP32C3

    config BOARD_TYPE_XMINI_C3_4G
        bool "Xmini C3 4G"
        depends on IDF_TARGET_ESP32C3

    config BOARD_TYPE_XMINI_C3
        bool "Xmini C3"
        depends on IDF_TARGET_ESP32C3

    config BOARD_TYPE_ESP_KORVO2_V3
        bool "Espressif Korvo2 V3"
        depends on IDF_TARGET_ESP32S3

    config BOARD_TYPE_ESP_SPARKBOT
        bool "Espressif SparkBot"
        depends on IDF_TARGET_ESP32S3

    config BOARD_TYPE_ESP_SPOT_S3
        bool "Espressif Spot-S3"
        depends on IDF_TARGET_ESP32S3

    config BOARD_TYPE_ESP_HI
        bool "Espressif ESP-HI"
        depends on IDF_TARGET_ESP32C3

    config BOARD_TYPE_ESP_BOX_3
        bool "Espressif ESP-BOX-3"
        depends on IDF_TARGET_ESP32S3

    config BOARD_TYPE_ESP_BOX
        bool "Espressif ESP-BOX"
        depends on IDF_TARGET_ESP32S3

    config BOARD_TYPE_ESP_BOX_LITE
        bool "Espressif ESP-BOX-Lite"
        depends on IDF_TARGET_ESP32S3

    config BOARD_TYPE_ESP_P4_FUNCTION_EV_BOARD
        bool "Espressif ESP-P4-Function-EV-Board"
        depends on IDF_TARGET_ESP32P4

    config BOARD_TYPE_ECHOEAR
        bool "EchoEar"
        depends on IDF_TARGET_ESP32S3

    config BOARD_TYPE_KEVIN_BOX_2
        bool "Kevin Box 2"
        depends on IDF_TARGET_ESP32S3

    config BOARD_TYPE_KEVIN_C3
        bool "Kevin C3"
        depends on IDF_TARGET_ESP32C3

    config BOARD_TYPE_KEVIN_SP_V3_DEV
        bool "Kevin SP V3"
        depends on IDF_TARGET_ESP32S3

    config BOARD_TYPE_KEVIN_SP_V4_DEV
        bool "Kevin SP V4"
        depends on IDF_TARGET_ESP32S3

    config BOARD_TYPE_KEVIN_YUYING_313LCD
        bool "YuyingTech 3.13LCD"
        depends on IDF_TARGET_ESP32S3

    config BOARD_TYPE_CGC
        bool "CGC"
        depends on IDF_TARGET_ESP32

    config BOARD_TYPE_CGC_144
        bool "CGC 144"
        depends on IDF_TARGET_ESP32

    config BOARD_TYPE_LICHUANG_DEV_S3
        bool "Lichuang Shizhanpai ESP32-S3"
        depends on IDF_TARGET_ESP32S3

    config BOARD_TYPE_LICHUANG_DEV_C3
        bool "Lichuang Shizhanpai ESP32-C3"
        depends on IDF_TARGET_ESP32C3

    config BOARD_TYPE_DF_K10
        bool "DFRobot Xingkong K10"
        depends on IDF_TARGET_ESP32S3

    config BOARD_TYPE_DF_S3_AI_CAM
        bool "DFRobot ESP32-S3 AI Camera Module"
        depends on IDF_TARGET_ESP32S3

    config BOARD_TYPE_MAGICLICK_S3_2P4
        bool "Magiclick S3 2.4 (nut than ky)"
        depends on IDF_TARGET_ESP32S3

    config BOARD_TYPE_MAGICLICK_S3_2P5
        bool "Magiclick S3 2.5 (nut than ky)"
        depends on IDF_TARGET_ESP32S3

    config BOARD_TYPE_MAGICLICK_C3
        bool "Magiclick C3 (nut than ky)"
        depends on IDF_TARGET_ESP32C3

    config BOARD_TYPE_MAGICLICK_C3_V2
        bool "Magiclick C3 v2 (nut than ky)"
        depends on IDF_TARGET_ESP32C3

    config BOARD_TYPE_M5STACK_CORE_S3
        bool "M5Stack CoreS3"
        depends on IDF_TARGET_ESP32S3

    config BOARD_TYPE_M5STACK_CORE_TAB5
        bool "M5Stack Tab5"
        depends on IDF_TARGET_ESP32P4

    config BOARD_TYPE_M5STACK_ATOM_S3_ECHO_BASE
        bool "M5Stack AtomS3 + Echo Base"
        depends on IDF_TARGET_ESP32S3

    config BOARD_TYPE_M5STACK_ATOM_S3R_ECHO_BASE
        bool "M5Stack AtomS3R + Echo Base"
        depends on IDF_TARGET_ESP32S3

    config BOARD_TYPE_M5STACK_ATOM_S3R_CAM_M12_ECHO_BASE
        bool "M5Stack AtomS3R CAM/M12 + Echo Base"
        depends on IDF_TARGET_ESP32S3

    config BOARD_TYPE_M5STACK_ATOM_ECHOS3R
        bool "M5Stack AtomEchoS3R"
        depends on IDF_TARGET_ESP32S3

    config BOARD_TYPE_M5STACK_ATOM_MATRIX_ECHO_BASE
        bool "M5Stack AtomMatrix + Echo Base"
        depends on IDF_TARGET_ESP32
    config BOARD_TYPE_WAVESHARE_S3_AUDIO_BOARD
        bool "Waveshare ESP32-S3-Audio-Board"
        depends on IDF_TARGET_ESP32S3

    config BOARD_TYPE_WAVESHARE_S3_TOUCH_AMOLED_1_8
        bool "Waveshare ESP32-S3-Touch-AMOLED-1.8"
        depends on IDF_TARGET_ESP32S3

    config BOARD_TYPE_WAVESHARE_S3_TOUCH_AMOLED_2_06
        bool "Waveshare ESP32-S3-Touch-AMOLED-2.06"
        depends on IDF_TARGET_ESP32S3

    config BOARD_TYPE_WAVESHARE_S3_TOUCH_AMOLED_1_75
        bool "Waveshare ESP32-S3-Touch-AMOLED-1.75"
        depends on IDF_TARGET_ESP32S3

    config BOARD_TYPE_WAVESHARE_S3_TOUCH_LCD_1_83
        bool "Waveshare ESP32-S3-Touch-LCD-1.83"
        depends on IDF_TARGET_ESP32S3

    config BOARD_TYPE_WAVESHARE_S3_TOUCH_LCD_4B
        bool "Waveshare ESP32-S3-Touch-LCD-4B"
        depends on IDF_TARGET_ESP32S3

    config BOARD_TYPE_WAVESHARE_S3_TOUCH_LCD_1_85C
        bool "Waveshare ESP32-S3-Touch-LCD-1.85C"
        depends on IDF_TARGET_ESP32S3

    config BOARD_TYPE_WAVESHARE_S3_TOUCH_LCD_1_85
        bool "Waveshare ESP32-S3-Touch-LCD-1.85"
        depends on IDF_TARGET_ESP32S3

    config BOARD_TYPE_WAVESHARE_S3_TOUCH_LCD_1_46
        bool "Waveshare ESP32-S3-Touch-LCD-1.46"
        depends on IDF_TARGET_ESP32S3

    config BOARD_TYPE_WAVESHARE_C6_LCD_1_69
        bool "Waveshare ESP32-C6-LCD-1.69"
        depends on IDF_TARGET_ESP32C6

    config BOARD_TYPE_WAVESHARE_C6_TOUCH_AMOLED_1_43
        bool "Waveshare ESP32-C6-Touch-AMOLED-1.43"
        depends on IDF_TARGET_ESP32C6

    config BOARD_TYPE_WAVESHARE_C6_TOUCH_AMOLED_1_32
        bool "Waveshare ESP32-C6-Touch-AMOLED-1.32"
        depends on IDF_TARGET_ESP32C6

    config BOARD_TYPE_WAVESHARE_S3_TOUCH_AMOLED_1_32
        bool "Waveshare ESP32-S3-Touch-AMOLED-1.32"
        depends on IDF_TARGET_ESP32S3

    config BOARD_TYPE_WAVESHARE_S3_TOUCH_LCD_3_49
        bool "Waveshare ESP32-S3-Touch-LCD-3.49"
        depends on IDF_TARGET_ESP32S3

    config BOARD_TYPE_WAVESHARE_S3_TOUCH_LCD_3_5
        bool "Waveshare ESP32-S3-Touch-LCD-3.5"
        depends on IDF_TARGET_ESP32S3

    config BOARD_TYPE_WAVESHARE_S3_TOUCH_LCD_3_5B
        bool "Waveshare ESP32-S3-Touch-LCD-3.5B"
        depends on IDF_TARGET_ESP32S3

    config BOARD_TYPE_WAVESHARE_P4_NANO
        bool "Waveshare ESP32-P4-NANO"
        depends on IDF_TARGET_ESP32P4

    config BOARD_TYPE_WAVESHARE_P4_WIFI6_TOUCH_LCD_4B
        bool "Waveshare ESP32-P4-WIFI6-Touch-LCD-4B"
        depends on IDF_TARGET_ESP32P4

    config BOARD_TYPE_WAVESHARE_P4_WIFI6_TOUCH_LCD_7B
        bool "Waveshare ESP32-P4-WIFI6-Touch-LCD-7B"
        depends on IDF_TARGET_ESP32P4

    config BOARD_TYPE_WAVESHARE_P4_WIFI6_TOUCH_LCD_XC
        bool "Waveshare ESP32-P4-WIFI6-Touch-LCD-3.4C/4C"
        depends on IDF_TARGET_ESP32P4

    config BOARD_TYPE_TUDOUZI
        bool "Tudouzi"
        depends on IDF_TARGET_ESP32S3

    config BOARD_TYPE_LILYGO_T_CIRCLE_S3
        bool "LILYGO T-Circle-S3"
        depends on IDF_TARGET_ESP32S3

    config BOARD_TYPE_LILYGO_T_CAMERAPLUS_S3_V1_0_V1_1
        bool "LILYGO T-CameraPlus-S3 V1.0/V1.1"
        depends on IDF_TARGET_ESP32S3

    config BOARD_TYPE_LILYGO_T_CAMERAPLUS_S3_V1_2
        bool "LILYGO T-CameraPlus-S3 V1.2"
        depends on IDF_TARGET_ESP32S3

    config BOARD_TYPE_LILYGO_T_DISPLAY_S3_PRO_MVSRLORA
        bool "LILYGO T-Display-S3-Pro-MVSRLora"
        depends on IDF_TARGET_ESP32S3

    config BOARD_TYPE_LILYGO_T_DISPLAY_S3_PRO_MVSRLORA_NO_BATTERY
        bool "LILYGO T-Display-S3-Pro-MVSRLora (khong pin)"
        depends on IDF_TARGET_ESP32S3

    config BOARD_TYPE_LILYGO_T_DISPLAY_P4
        bool "LILYGO T-Display-P4"
        depends on IDF_TARGET_ESP32P4

    config BOARD_TYPE_MOVECALL_MOJI_ESP32S3
        bool "Movecall Moji (phien ban mo rong Xiaozhi AI)"
        depends on IDF_TARGET_ESP32S3

    config BOARD_TYPE_MOVECALL_CUICAN_ESP32S3
        bool "Movecall CuiCan AI Pendant"
        depends on IDF_TARGET_ESP32S3

    config BOARD_TYPE_ATK_DNESP32S3
        bool "Bo phat trien ATK DNESP32S3"
        depends on IDF_TARGET_ESP32S3

    config BOARD_TYPE_ATK_DNESP32S3_BOX
        bool "ATK DNESP32S3-BOX"
        depends on IDF_TARGET_ESP32S3

    config BOARD_TYPE_ATK_DNESP32S3_BOX0
        bool "ATK DNESP32S3-BOX0"
        depends on IDF_TARGET_ESP32S3

    config BOARD_TYPE_ATK_DNESP32S3_BOX2_WIFI
        bool "ATK DNESP32S3-BOX2-WIFI"
        depends on IDF_TARGET_ESP32S3

    config BOARD_TYPE_ATK_DNESP32S3_BOX2_4G
        bool "ATK DNESP32S3-BOX2-4G"
        depends on IDF_TARGET_ESP32S3

    config BOARD_TYPE_ATK_DNESP32S3M_WIFI
        bool "ATK DNESP32S3M-WIFI"
        depends on IDF_TARGET_ESP32S3

    config BOARD_TYPE_ATK_DNESP32S3M_4G
        bool "ATK DNESP32S3M-4G"
        depends on IDF_TARGET_ESP32S3

    config BOARD_TYPE_DU_CHATX
        bool "Dudu Dev Board CHATX (WiFi)"
        depends on IDF_TARGET_ESP32S3

    config BOARD_TYPE_TAIJI_PI_S3
        bool "Taiji-Pi ESP32-S3"
        depends on IDF_TARGET_ESP32S3

    config BOARD_TYPE_XINGZHI_CUBE_0_85TFT_WIFI
        bool "WumingTech Xingzhi 0.85 (WiFi)"
        depends on IDF_TARGET_ESP32S3

    config BOARD_TYPE_XINGZHI_CUBE_0_85TFT_ML307
        bool "WumingTech Xingzhi 0.85 (ML307)"
        depends on IDF_TARGET_ESP32S3

    config BOARD_TYPE_XINGZHI_CUBE_0_96OLED_WIFI
        bool "WumingTech Xingzhi 0.96 OLED (WiFi)"
        depends on IDF_TARGET_ESP32S3

    config BOARD_TYPE_XINGZHI_CUBE_0_96OLED_ML307
        bool "WumingTech Xingzhi 0.96 OLED (ML307)"
        depends on IDF_TARGET_ESP32S3

    config BOARD_TYPE_XINGZHI_CUBE_1_54TFT_WIFI
        bool "WumingTech Xingzhi 1.54 TFT (WiFi)"
        depends on IDF_TARGET_ESP32S3

    config BOARD_TYPE_XINGZHI_CUBE_1_54TFT_ML307
        bool "WumingTech Xingzhi 1.54 TFT (ML307)"
        depends on IDF_TARGET_ESP32S3

    config BOARD_TYPE_SEEED_STUDIO_SENSECAP_WATCHER
        bool "Seeed Studio SenseCAP Watcher"
        depends on IDF_TARGET_ESP32S3

    config BOARD_TYPE_DOIT_S3_AIBOX
        bool "DOIT S3 AI Companion Box"
        depends on IDF_TARGET_ESP32S3

    config BOARD_TYPE_MIXGO_NOVA
        bool "Yuankong MixGo Nova (Youth)"
        depends on IDF_TARGET_ESP32S3

    config BOARD_TYPE_GENJUTECH_S3_1_54TFT
        bool "GenjuTech 1.54 (ESP32-S3)"
        depends on IDF_TARGET_ESP32S3

    config BOARD_TYPE_ESP_S3_LCD_EV_Board
        bool "Espressif ESP32-S3 LCD EV Board"
        depends on IDF_TARGET_ESP32S3

    config BOARD_TYPE_ESP_S3_LCD_EV_Board_2
        bool "Espressif ESP32-S3 LCD EV Board 2"
        depends on IDF_TARGET_ESP32S3

    config BOARD_TYPE_ZHENGCHEN_1_54TFT_WIFI
        bool "ZhengchenTech 1.54 TFT (WiFi)"
        depends on IDF_TARGET_ESP32S3

    config BOARD_TYPE_ZHENGCHEN_1_54TFT_ML307
        bool "ZhengchenTech 1.54 TFT (ML307)"
        depends on IDF_TARGET_ESP32S3

    config BOARD_TYPE_MINSI_K08_DUAL
        bool "MinsiTech K08 (DUAL)"
        depends on IDF_TARGET_ESP32S3

    config BOARD_TYPE_SPOTPEAR_ESP32_S3_1_54_MUMA
        bool "Spotpear ESP32-S3-1.54-MUMA"
        depends on IDF_TARGET_ESP32S3

    config BOARD_TYPE_SPOTPEAR_ESP32_S3_1_28_BOX
        bool "Spotpear ESP32-S3-1.28-BOX"
        depends on IDF_TARGET_ESP32S3

    config BOARD_TYPE_OTTO_ROBOT
        bool "Otto Robot"
        depends on IDF_TARGET_ESP32S3

    config BOARD_TYPE_ELECTRON_BOT
        bool "ElectronBot"
        depends on IDF_TARGET_ESP32S3

    config BOARD_TYPE_JIUCHUAN
        bool "Jiuchuan Intelligent"
        depends on IDF_TARGET_ESP32S3

    config BOARD_TYPE_LABPLUS_MPYTHON_V3
        bool "Labplus mPython V3"
        depends on IDF_TARGET_ESP32S3

    config BOARD_TYPE_LABPLUS_LEDONG_V2
        bool "Labplus Ledong V2"
        depends on IDF_TARGET_ESP32S3

    config BOARD_TYPE_SURFER_C3_1_14TFT
        bool "Surfer-C3 1.14TFT"
        depends on IDF_TARGET_ESP32C3

    config BOARD_TYPE_YUNLIAO_S3
        bool "Xiaozhi CloudChat-S3"
        depends on IDF_TARGET_ESP32S3

    config BOARD_TYPE_WIRELESS_TAG_WTP4C5MP07S
        bool "Wireless-Tag WTP4C5MP07S"
        depends on IDF_TARGET_ESP32P4

    config BOARD_TYPE_AIPI_LITE
        bool "AIPI-Lite"
        depends on IDF_TARGET_ESP32S3
endchoice

choice
    depends on BOARD_TYPE_LILYGO_T_DISPLAY_P4
    prompt "Chon loai man hinh"
    default SCREEN_TYPE_HI8561

    config SCREEN_TYPE_HI8561
        bool "HI8561"

    config SCREEN_TYPE_RM69A10
        bool "RM69A10"
endchoice

choice
    depends on BOARD_TYPE_LILYGO_T_DISPLAY_P4
    prompt "Chon dinh dang mau man hinh"
    default SCREEN_PIXEL_FORMAT_RGB565

    config SCREEN_PIXEL_FORMAT_RGB565
        bool "RGB565"

    config SCREEN_PIXEL_FORMAT_RGB888
        bool "RGB888"
endchoice

choice ESP_S3_LCD_EV_Board_Version_TYPE
    depends on BOARD_TYPE_ESP_S3_LCD_EV_Board
    prompt "Loai ESP32-S3 LCD EV Board"
    default ESP_S3_LCD_EV_Board_1p4

    config ESP_S3_LCD_EV_Board_1p4
        bool "ESP32-S3 LCD EV Board-MB_V1.4"

    config ESP_S3_LCD_EV_Board_1p5
        bool "ESP32-S3 LCD EV Board-MB_V1.5"
endchoice

choice DISPLAY_OLED_TYPE
    depends on BOARD_TYPE_BREAD_COMPACT_WIFI || BOARD_TYPE_BREAD_COMPACT_ML307 || BOARD_TYPE_BREAD_COMPACT_ESP32
    prompt "Loai OLED"
    default OLED_SSD1306_128X32
    help
        Kieu man hinh OLED don sac

    config OLED_SSD1306_128X32
        bool "SSD1306 128x32"

    config OLED_SSD1306_128X64
        bool "SSD1306 128x64"

    config OLED_SH1106_128X64
        bool "SH1106 128x64"
endchoice

choice DISPLAY_LCD_TYPE
    depends on BOARD_TYPE_BREAD_COMPACT_WIFI_LCD || BOARD_TYPE_BREAD_COMPACT_ESP32_LCD || BOARD_TYPE_CGC || BOARD_TYPE_WAVESHARE_P4_NANO || BOARD_TYPE_WAVESHARE_P4_WIFI6_TOUCH_LCD_XC || BOARD_TYPE_BREAD_COMPACT_WIFI_CAM
    prompt "Loai LCD"
    default LCD_ST7789_240X320
    help
        Kieu man hinh LCD

    config LCD_ST7789_240X320
        bool "ST7789 240x320 IPS"

    config LCD_ST7789_240X320_NO_IPS
        bool "ST7789 240x320 Non-IPS"

    config LCD_ST7789_170X320
        bool "ST7789 170x320"

    config LCD_ST7789_172X320
        bool "ST7789 172x320"

    config LCD_ST7789_240X280
        bool "ST7789 240x280"

    config LCD_ST7789_240X240
        bool "ST7789 240x240"

    config LCD_ST7789_240X240_7PIN
        bool "ST7789 240x240 7PIN"

    config LCD_ST7789_240X135
        bool "ST7789 240x135"

    config LCD_ST7735_128X160
        bool "ST7735 128x160"

    config LCD_ST7735_128X128
        bool "ST7735 128x128"

    config LCD_ST7796_320X480
        bool "ST7796 320x480 IPS"

    config LCD_ST7796_320X480_NO_IPS
        bool "ST7796 320x480 Non-IPS"

    config LCD_ILI9341_240X320
        bool "ILI9341 240x320"

    config LCD_ILI9341_240X320_NO_IPS
        bool "ILI9341 240x320 Non-IPS"

    config LCD_GC9A01_240X240
        bool "GC9A01 240x240 tron"

    config LCD_TYPE_800_1280_10_1_INCH
        bool "Waveshare 101M 800x1280 IPS CT K"

    config LCD_TYPE_800_1280_10_1_INCH_A
        bool "Waveshare 10.1 DSI TOUCH A"

    config LCD_TYPE_800_800_3_4_INCH
        bool "ESP32-P4 WIFI6 LCD 3.4C tron 800x800"

    config LCD_TYPE_720_720_4_INCH
        bool "ESP32-P4 WIFI6 LCD 4C tron 720x720"

    config LCD_CUSTOM
        bool "LCD tuy chinh (tu khai bao tham so man hinh)"
endchoice

choice DISPLAY_ESP32S3_KORVO2_V3
    depends on BOARD_TYPE_ESP_KORVO2_V3
    prompt "Loai LCD cho ESP32S3_KORVO2_V3"
    default ESP32S3_KORVO2_V3_LCD_ST7789
    help
        Kieu man hinh LCD

    config ESP32S3_KORVO2_V3_LCD_ST7789
        bool "ST7789 240x280"

    config ESP32S3_KORVO2_V3_LCD_ILI9341
        bool "ILI9341 240x320"
endchoice

choice DISPLAY_ESP32S3_AUDIO_BOARD
    depends on BOARD_TYPE_WAVESHARE_S3_AUDIO_BOARD
    prompt "Loai LCD cho ESP32S3_AUDIO_BOARD"
    default AUDIO_BOARD_LCD_JD9853
    help
        Kieu man hinh LCD

    config AUDIO_BOARD_LCD_JD9853
        bool "JD9853 320x172"

    config AUDIO_BOARD_LCD_ST7789
        bool "ST7789 240x320"
endchoice

choice DISPLAY_STYLE
    prompt "Chon kieu hien thi"
    default USE_DEFAULT_MESSAGE_STYLE
    help
        Chon kieu hien thi cho thiet bi Xiaozhi

    config USE_DEFAULT_MESSAGE_STYLE
        bool "Bat kieu hien thi mac dinh"

    config USE_WECHAT_MESSAGE_STYLE
        bool "Bat kieu hien thi dang chat (WeChat)"

    config USE_EMOTE_MESSAGE_STYLE
        bool "Kieu hien thi cam xuc (Emote animation)"
        depends on BOARD_TYPE_ESP_BOX_3 || BOARD_TYPE_ECHOEAR || BOARD_TYPE_LICHUANG_DEV_S3
endchoice

choice WAKE_WORD_TYPE
    prompt "Kieu thuc thi tu khoa danh thuc"
    default USE_AFE_WAKE_WORD if (IDF_TARGET_ESP32S3 || IDF_TARGET_ESP32P4) && SPIRAM
    default WAKE_WORD_DISABLED
    help
        Chon kieu cai dat tu khoa danh thuc (wake word)

    config WAKE_WORD_DISABLED
        bool "Tat"
        help
            Tat hoan toan tinh nang nhan dien tu khoa danh thuc

    config USE_ESP_WAKE_WORD
        bool "Mo hinh Wakenet (khong dung AFE)"
        depends on IDF_TARGET_ESP32C3 || IDF_TARGET_ESP32C5 || IDF_TARGET_ESP32C6 || (IDF_TARGET_ESP32 && SPIRAM)
        help
            Ho tro ESP32-C3, ESP32-C5, ESP32-C6 va ESP32 (co PSRAM)

    config USE_AFE_WAKE_WORD
        bool "Mo hinh Wakenet (kem AFE)"
        depends on (IDF_TARGET_ESP32S3 || IDF_TARGET_ESP32P4) && SPIRAM
        help
            Ho tro AEC neu co, yeu cau ESP32-S3 hoac ESP32-P4 va PSRAM

    config USE_CUSTOM_WAKE_WORD
        bool "Mo hinh Multinet (tu khoa danh thuc tuy chinh)"
        depends on (IDF_TARGET_ESP32S3 || IDF_TARGET_ESP32P4) && SPIRAM
        help
            Yeu cau ESP32-S3 hoac ESP32-P4 va PSRAM
endchoice

config CUSTOM_WAKE_WORD
    string "Tu khoa danh thuc tuy chinh"
    default "xiao tu dou"
    depends on USE_CUSTOM_WAKE_WORD
    help
        Tu khoa danh thuc tuy chinh, dung pinyin cho tieng Trung, cac tu cach nhau boi dau cach

config CUSTOM_WAKE_WORD_DISPLAY
    string "Chuoi hien thi khi danh thuc tuy chinh"
    default "Tieu Khoai Tay"
    depends on USE_CUSTOM_WAKE_WORD
    help
        Loi chao gui len may chu sau khi phat hien tu khoa danh thuc

config CUSTOM_WAKE_WORD_THRESHOLD
    int "Nguong tu khoa danh thuc tuy chinh (%)"
    default 20
    range 1 99
    depends on USE_CUSTOM_WAKE_WORD
    help
        Nguong kich hoat tu khoa danh thuc, trong khoang 1-99, gia tri cang nho thi cang nhay

config SEND_WAKE_WORD_DATA
    bool "Gui du lieu tu khoa danh thuc"
    default y
    depends on USE_AFE_WAKE_WORD || USE_CUSTOM_WAKE_WORD
    help
        Gui du lieu am thanh cua tu khoa danh thuc len may chu như thong diep dau tien va cho phan hoi

config USE_AUDIO_PROCESSOR
    bool "Bat xu ly tieng on am thanh"
    default y
    depends on (IDF_TARGET_ESP32S3 || IDF_TARGET_ESP32P4) && SPIRAM
    help
        Yeu cau ESP32-S3 hoac ESP32-P4 va PSRAM

config USE_DEVICE_AEC
    bool "Bat AEC tren thiet bi"
    default n
    depends on USE_AUDIO_PROCESSOR && (BOARD_TYPE_ESP_BOX_3 || BOARD_TYPE_ESP_BOX || BOARD_TYPE_ESP_BOX_LITE \
        || BOARD_TYPE_LICHUANG_DEV_S3 || BOARD_TYPE_ESP_KORVO2_V3 || BOARD_TYPE_WAVESHARE_S3_TOUCH_AMOLED_1_75 || BOARD_TYPE_WAVESHARE_S3_TOUCH_LCD_1_83 \
        || BOARD_TYPE_WAVESHARE_S3_TOUCH_AMOLED_2_06 || BOARD_TYPE_WAVESHARE_S3_TOUCH_LCD_4B || BOARD_TYPE_WAVESHARE_P4_WIFI6_TOUCH_LCD_4B || BOARD_TYPE_WAVESHARE_P4_WIFI6_TOUCH_LCD_7B \
        || BOARD_TYPE_WAVESHARE_P4_WIFI6_TOUCH_LCD_XC || BOARD_TYPE_ESP_S3_LCD_EV_Board_2 || BOARD_TYPE_YUNLIAO_S3 \
        || BOARD_TYPE_ECHOEAR || BOARD_TYPE_WAVESHARE_S3_TOUCH_LCD_3_49)
    help
        De hoat dong chinh xac, AEC chay tren thiet bi can duong tham chieu tin hieu loa sach
        va co cach ly am hoc tot giua micro va loa.

config USE_SERVER_AEC
    bool "Bat AEC phia may chu (khong on dinh)"
    default n
    depends on USE_AUDIO_PROCESSOR
    help
        De hoat dong chinh xac, AEC phia may chu can duoc ho tro tu phia server

config USE_AUDIO_DEBUGGER
    bool "Bat che do go loi am thanh"
    default n
    help
        Gui du lieu am thanh qua UDP den may tinh chu de go loi

config AUDIO_DEBUG_UDP_SERVER
    string "Dia chi UDP Server de go loi am thanh"
    default "192.168.2.100:8000"
    depends on USE_AUDIO_DEBUGGER
    help
        Dia chi UDP server, dinh dang IP:PORT, dung de nhan du lieu am thanh cho muc dich go loi

config USE_ACOUSTIC_WIFI_PROVISIONING
    bool "Bat cau hinh WiFi bang am thanh"
    default n
    help
        Truyen thong tin WiFi qua song am

config RECEIVE_CUSTOM_MESSAGE
    bool "Bat nhan thong diep tuy chinh"
    default n
    help
        Cho phep thiet bi nhan thong diep tuy chinh tu may chu (uu tien qua giao thuc MQTT)

menu "Cau hinh Camera"
    depends on !IDF_TARGET_ESP32

    comment "Canh bao: Hay doc ky phan tro giup truoc khi thay doi cac thiet lap nay."

    config XIAOZHI_ENABLE_HARDWARE_JPEG_ENCODER
        bool "Bat bo ma hoa JPEG bang phan cung"
        default y
        depends on SOC_JPEG_ENCODE_SUPPORTED
        help
            Su dung bo ma hoa JPEG phan cung de ma hoa anh sang JPEG.

    config XIAOZHI_ENABLE_CAMERA_DEBUG_MODE
        bool "Bat che do go loi camera"
        default n
        help
            In thong tin debug cua camera ra console.

    config XIAOZHI_ENABLE_CAMERA_ENDIANNESS_SWAP
        bool "Bat dao thu tu byte bo dem camera bang phan mem"
        default n
        depends on !CAMERA_SENSOR_SWAP_PIXEL_BYTE_ORDER
        help
            Tuy chon nay xem bo dem camera nhu mang uint16_t[] va dao thu tu byte cua tung phan tu.
            Chi nen thay doi boi ky su tich hop bo phat trien.

    menuconfig XIAOZHI_ENABLE_ROTATE_CAMERA_IMAGE
        bool "Bat xoay anh tu camera"
        default n
        help
            Bat xoay anh camera de hien thi dung chieu.

    if XIAOZHI_ENABLE_ROTATE_CAMERA_IMAGE
        choice XIAOZHI_CAMERA_IMAGE_ROTATION_ANGLE
            prompt "Goc xoay anh camera (theo chieu kim dong ho)"
            default XIAOZHI_CAMERA_IMAGE_ROTATION_ANGLE_90
            help
                Goc xoay anh camera.

            config XIAOZHI_CAMERA_IMAGE_ROTATION_ANGLE_90
                bool "90"

            config XIAOZHI_CAMERA_IMAGE_ROTATION_ANGLE_270
                bool "270"

            comment "Voi xoay 180, hay dung HFlip + VFlip thay vi tuy chon nay"
        endchoice
    endif
endmenu

menu "TAIJIPAI_S3_CONFIG"
    depends on BOARD_TYPE_TAIJI_PI_S3

    choice I2S_TYPE_TAIJIPI_S3
        prompt "Chon kieu I2S cho Taiji-Pi S3"
        default TAIJIPAI_I2S_TYPE_STD
        help
            Lua chon kieu I2S

        config TAIJIPAI_I2S_TYPE_STD
            bool "I2S kieu STD"

        config TAIJIPAI_I2S_TYPE_PDM
            bool "I2S kieu PDM"
    endchoice

    config I2S_USE_2SLOT
        bool "Bat I2S 2 kenh (2 Slot)"
        default y
        help
            Bat am thanh hai kenh (stereo)
endmenu

endmenu
```
